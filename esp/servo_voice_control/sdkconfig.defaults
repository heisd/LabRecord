## esp/servo_voice_control/sdkconfig.defaults
```kconfig
# micro-ROS 需要的配置
CONFIG_MICRO_ROS_ESP_NETIF_WLAN=y
CONFIG_MICRO_ROS_ESP_XRCE_DDS_MIDDLEWARE=y

# WiFi
CONFIG_ESP_WIFI_SSID="WHEELTEC_S300"
CONFIG_ESP_WIFI_PASSWORD="dongguan"

# 增大栈空间
CONFIG_ESP_MAIN_TASK_STACK_SIZE=16384
CONFIG_FREERTOS_TIMER_TASK_STACK_DEPTH=4096

# PSRAM（如果你的板子有）
CONFIG_ESP32S3_SPIRAM_SUPPORT=y
CONFIG_SPIRAM_MODE_OCT=y
```

## esp/voice_micro_ros/sdkconfig.defaults
```kconfig
# micro-ROS 需要的配置
CONFIG_MICRO_ROS_ESP_NETIF_WLAN=y
CONFIG_MICRO_ROS_ESP_XRCE_DDS_MIDDLEWARE=y

# WiFi
CONFIG_ESP_WIFI_SSID="WHEELTEC_S300"
CONFIG_ESP_WIFI_PASSWORD="dongguan"

# 增大栈空间
CONFIG_ESP_MAIN_TASK_STACK_SIZE=16384
CONFIG_FREERTOS_TIMER_TASK_STACK_DEPTH=4096

# 下面是我们I2S麦克风和ESP-SR需要的配置
CONFIG_SR_MN_EN_MULTINET6_QUANT=y
CONFIG_SR_WN_WN9_HILEXIN=y

# I2S 麦克风
CONFIG_ESP32S3_DEFAULT_CPU_FREQ_240=y

# PSRAM（ESP-SR 必须）
CONFIG_ESP32S3_SPIRAM_SUPPORT=y
CONFIG_SPIRAM_MODE_OCT=y
CONFIG_SPIRAM_SPEED_80M=y
```
